## poky/build/conf/bblayers.conf
```bitbake
# POKY_BBLAYERS_CONF_VERSION is increased each time build/conf/bblayers.conf
# changes incompatibly
POKY_BBLAYERS_CONF_VERSION = "2"

BBPATH = "${TOPDIR}"
BBFILES ?= ""

BBLAYERS ?= " \
  ${TOPDIR}/../meta \
  ${TOPDIR}/../meta-poky \
  ${TOPDIR}/../meta-yocto-bsp \
  ${TOPDIR}/../meta-raspberrypi \
  ${TOPDIR}/../meta-openembedded/meta-oe \
  ${TOPDIR}/../meta-openembedded/meta-multimedia \
  ${TOPDIR}/../meta-openembedded/meta-networking \
  ${TOPDIR}/../meta-openembedded/meta-python \
  ${TOPDIR}/../meta-python2 \
  ${TOPDIR}/../meta-qt5 \
  ${TOPDIR}/../meta-HU \
  ${TOPDIR}/../meta-env \
  ${TOPDIR}/../meta-gui \
  ${TOPDIR}/../meta-control \
  ${TOPDIR}/../meta-openembedded/meta-filesystems \
  ${TOPDIR}/../meta-virtualization \
\
  "

# meta-rauc 관련 레이어들
# /mnt/ota/seame-workstation10/test/poky/meta-rauc
# /mnt/ota/seame-workstation10/test/poky/meta-rauc-raspberrypi
```

## poky/meta-HU/wic/ab-partition.wks
```
# Boot partition (VFAT)
part /boot --source bootimg-partition --ondisk mmcblk0 --fstype=vfat --label boot --align 4 --size 50

# RootFS A (EXT4)
part /rootfsA --source rootfs --ondisk mmcblk0 --fstype=ext4 --label rootfsA --align 4 --size 10240

# RootFS B (EXT4)
part /rootfsB --source rootfs --ondisk mmcblk0 --fstype=ext4 --label rootfsB --align 4 --size 10240

# # Data Partition
# part /data --ondisk mmcblk0 --fstype=ext4 --label data --align 4 --size 2048

# # Home Partition
# part /home --ondisk mmcblk0 --fstype=ext4 --label home --align 4 --size 2048

# Bootloader (for RPi)
bootloader --ptable msdos
```

## poky/meta-raspberrypi/wic/ab-partition.wks
```
part /boot --source bootimg-partition --ondisk mmcblk0 --fstype=vfat --label boot --align 4
part /rootfsA --source rootfs --ondisk mmcblk0 --fstype=ext4 --label rootfsA --align 4
part /rootfsB --source rootfs --ondisk mmcblk0 --fstype=ext4 --label rootfsB --align 4
bootloader --ptable msdos
```

## poky/meta-raspberrypi/wic/sdimage-raspberrypi.wks
```
# short-description: Create Raspberry Pi SD card image
# long-description: Creates a partitioned SD card image for use with
# Raspberry Pi. Boot files are located in the first vfat partition.

#part /boot --source bootimg-partition --ondisk mmcblk0 --fstype=vfat --label boot --active --align 4096 --size 20
#part / --source rootfs --ondisk mmcblk0 --fstype=ext4 --label root --align 4096


# short-description: Create Raspberry Pi SD card image with A/B partitioning
# long-description: Creates a partitioned SD card image for Raspberry Pi with
# A/B rootfs slots for RAUC updates.

# Boot partition (VFAT)
part /boot --source bootimg-partition --ondisk mmcblk0 --fstype=vfat --label boot --active --align 4096 --size 20

# RootFS A partition (EXT4)
part /rootfsA --source rootfs --ondisk mmcblk0 --fstype=ext4 --label rootfsA --align 4096

# RootFS B partition (EXT4)
part /rootfsB --source rootfs --ondisk mmcblk0 --fstype=ext4 --label rootfsB --align 4096

# Bootloader configuration
bootloader --ptable msdos
```
